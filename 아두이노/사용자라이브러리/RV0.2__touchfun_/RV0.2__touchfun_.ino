#include <SPI.h>
#include <Wire.h>
#include <Arduino.h>
#include <Adafruit_GFX.h>
#include <Adafruit_SH1106.h>
#include <string.h>
#include <ESP8266WiFi.h>
#include <ESP8266WiFiMulti.h>
#include <time.h>
#include <ArduinoJson.h>
#include <ESP8266HTTPClient.h>
#include <WiFiClient.h>



#define OLED_RESET -1
Adafruit_SH1106 display(OLED_RESET);
int touchSensor = 15;  // 터치센서 핀 설정
int count = 0;            // 손을 얼마나 오래 대었는지 카운트 해주는 변수




const char* ssid = "U+Net16C5";
const char* password = "1C18047287";


int tmn=0; //최저기온
int tmx=0; //최고기온

int wloop=0; 
int wloopi=0; 
const unsigned char *skyimg0=NULL;
const unsigned char *skyimg1=NULL;
const unsigned char *skyimg2=NULL;
const unsigned char *skyimg3=NULL;
const unsigned char *skyimg4=NULL;
const unsigned char *skyimg5=NULL;
const unsigned char *skyimg6=NULL;
const unsigned char *skyimg7=NULL;
const unsigned char *skyimg8=NULL;
const unsigned char *skyimg9=NULL;
const unsigned char *skyimg10=NULL;
const unsigned char *skyimg11=NULL;
const unsigned char *skyimg12=NULL;
const unsigned char** skyimgary[13]={&skyimg0,&skyimg1,&skyimg2,&skyimg3,&skyimg4,&skyimg5,&skyimg6,&skyimg7,&skyimg8,&skyimg9,&skyimg10,&skyimg11,&skyimg12};

int timezone = 9;

int c_result=0;

struct Sts{
    int nt=0;//기온
    int sky=0;//하늘상태,강수량 포함.
    int fcstDate=0;//예상날짜
    int fcstTime=0;//예상시간
     };
Sts stsv[13];

const unsigned char boot [] PROGMEM = {
0xff, 0xff, 0xff, 0xff, 0xff, 0xff, 0xff, 0xff, 0xff, 0xff, 0xff, 0xff, 0xff, 0xff, 0xff, 0xff, 
  0xff, 0xff, 0xff, 0xff, 0xff, 0xff, 0xff, 0xff, 0xff, 0xff, 0xff, 0xff, 0xff, 0xff, 0xff, 0xff, 
  0xff, 0xff, 0xff, 0xff, 0xff, 0xff, 0xff, 0xff, 0xff, 0xff, 0xf8, 0x00, 0x7f, 0xff, 0xff, 0xff, 
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  0xff, 0xff, 0xff, 0xff, 0xff, 0xff, 0xff, 0xff, 0xff, 0xff, 0xff, 0xff, 0xff, 0xff, 0xe7, 0xff
 };
// '3741356-sun-sunny-weather64_108871', 64x64px
const unsigned char sunny64 [] PROGMEM = {
  0xff, 0xff, 0xff, 0xff, 0xff, 0xff, 0xff, 0xff, 0xff, 0xff, 0xff, 0xff, 0xff, 0xff, 0xff, 0xff, 
  0xff, 0xff, 0xff, 0xfc, 0x3f, 0xff, 0xff, 0xff, 0xff, 0xff, 0xff, 0xfc, 0x3f, 0xff, 0xff, 0xff, 
  0xff, 0xff, 0xff, 0xfc, 0x3f, 0xff, 0xff, 0xff, 0xff, 0xff, 0xff, 0xfc, 0x3f, 0xff, 0xff, 0xff, 
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  0xff, 0xff, 0xff, 0xff, 0xff, 0xff, 0xff, 0xff, 0xff, 0xff, 0xff, 0xff, 0xff, 0xff, 0xff, 0xff
};
// '3741357-cloud-cloudy-partly-cloudy64-weather_108867', 64x64px
const unsigned char cloudy64[] PROGMEM = {
  0xff, 0xff, 0xff, 0xff, 0xff, 0xff, 0xff, 0xff, 0xff, 0xff, 0xff, 0xff, 0xff, 0xff, 0xff, 0xff, 
  0xff, 0xff, 0xff, 0xff, 0xff, 0xff, 0xff, 0xff, 0xff, 0xff, 0xff, 0xff, 0xff, 0xff, 0xff, 0xff, 
  0xff, 0xff, 0xff, 0xff, 0xff, 0xff, 0xff, 0xff, 0xff, 0xff, 0xff, 0xff, 0xff, 0xff, 0xff, 0xff, 
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  0xff, 0xff, 0xff, 0xff, 0xff, 0xff, 0xff, 0xff, 0xff, 0xff, 0xff, 0xff, 0xff, 0xff, 0xff, 0xff
};
// '3741359-cloud-overcast-weather_108879', 64x64px
const unsigned char overcast64 [] PROGMEM = {
  0xff, 0xff, 0xff, 0xff, 0xff, 0xff, 0xff, 0xff, 0xff, 0xff, 0xff, 0xff, 0xff, 0xff, 0xff, 0xff, 
  0xff, 0xff, 0xff, 0xff, 0xff, 0xff, 0xff, 0xff, 0xff, 0xff, 0xff, 0xff, 0xff, 0xff, 0xff, 0xff, 
  0xff, 0xff, 0xff, 0xff, 0xff, 0xff, 0xff, 0xff, 0xff, 0xff, 0xff, 0xff, 0xff, 0xff, 0xff, 0xff, 
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  0xff, 0xff, 0xff, 0xff, 0xff, 0xff, 0xff, 0xff, 0xff, 0xff, 0xff, 0xff, 0xff, 0xff, 0xff, 0xff
};
// 'rain_weather64_3371', 64x64px
const unsigned char rainy64 [] PROGMEM = {
  0xff, 0xff, 0xff, 0xfc, 0x3f, 0xff, 0xff, 0xff, 0xff, 0xff, 0xff, 0xf8, 0x1f, 0xff, 0xff, 0xf7, 
  0xff, 0xff, 0xff, 0xf8, 0x1f, 0xff, 0xff, 0xe7, 0xff, 0xff, 0xff, 0xf8, 0x1f, 0xff, 0xff, 0xe3, 
  0xf9, 0xff, 0xff, 0xf8, 0x1f, 0xff, 0xff, 0xc1, 0xf8, 0xff, 0xff, 0xf8, 0x1f, 0xff, 0xff, 0x81, 
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  0xff, 0xff, 0xe0, 0x03, 0xff, 0xff, 0xff, 0xff, 0xff, 0xff, 0xf8, 0x07, 0xff, 0xff, 0xff, 0xff
};

// 'sleet_application_climate64_2877', 64x64px
const unsigned char sleet64 [] PROGMEM = {
  0xff, 0xff, 0xff, 0xff, 0x80, 0x1f, 0xff, 0xff, 0xff, 0xff, 0xff, 0xfe, 0x00, 0x03, 0xff, 0xff, 
  0xff, 0xff, 0xff, 0xf8, 0x00, 0x01, 0xff, 0xff, 0xff, 0xff, 0xff, 0xf0, 0x00, 0x00, 0x7f, 0xff, 
  0xff, 0xff, 0xff, 0xe0, 0x00, 0x00, 0x3f, 0xff, 0xff, 0xff, 0xff, 0xc0, 0x0f, 0x00, 0x1f, 0xff, 
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  0xff, 0xff, 0xff, 0xf8, 0xff, 0xff, 0xff, 0xff, 0xff, 0xff, 0xff, 0xf8, 0xff, 0xff, 0xff, 0xff
};

// '3741358-christmas-cold-snow64-weather_108876', 64x64px
const unsigned char snow64 [] PROGMEM = {
  0xff, 0xff, 0xff, 0xff, 0xff, 0xff, 0xff, 0xff, 0xff, 0xff, 0xff, 0xff, 0xff, 0xff, 0xff, 0xff, 
  0xff, 0xff, 0xff, 0xff, 0xff, 0xff, 0xff, 0xff, 0xff, 0xff, 0xff, 0xfe, 0x7f, 0xff, 0xff, 0xff, 
  0xff, 0xff, 0xff, 0xfc, 0x3f, 0xff, 0xff, 0xff, 0xff, 0xff, 0xfe, 0x38, 0x1c, 0x7f, 0xff, 0xff, 
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  0xff, 0xff, 0xff, 0xff, 0xff, 0xff, 0xff, 0xff, 0xff, 0xff, 0xff, 0xff, 0xff, 0xff, 0xff, 0xff
};
// 'sunandcloudwithrain64_87433', 64x64px
const unsigned char rcd64 [] PROGMEM = {
  0xff, 0xff, 0xff, 0xff, 0xff, 0xff, 0xff, 0xff, 0xff, 0xff, 0xff, 0xff, 0xfe, 0x1f, 0xff, 0xff, 
  0xff, 0xff, 0xff, 0xff, 0xfe, 0x1f, 0xff, 0xff, 0xff, 0xff, 0xff, 0xff, 0xfe, 0x1f, 0xff, 0xff, 
  0xff, 0xff, 0xff, 0xff, 0xfe, 0x1f, 0xff, 0xff, 0xff, 0xff, 0xff, 0xff, 0xfe, 0x1f, 0xff, 0xff, 
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  0xff, 0xff, 0x8f, 0xff, 0xff, 0xff, 0xff, 0xff, 0xff, 0xff, 0xff, 0xff, 0xff, 0xff, 0xff, 0xff
};

const unsigned char c [] PROGMEM = {
  0x00, 0x00, 0x00, 0x00, 0x00, 0x00, 0x00, 0x00, 0x00, 0x00, 0x00, 0x00, 0x00, 0x00, 0x00, 0x00, 
  0x00, 0x00, 0x00, 0x00, 0x00, 0x00, 0x00, 0x00, 0x00, 0x00, 0x00, 0x00, 0x00, 0x00, 0x00, 0x00, 
  0x03, 0xc0, 0x7f, 0x80, 0x02, 0x61, 0xff, 0x80, 0x02, 0x23, 0xfb, 0x80, 0x03, 0x47, 0xc0, 0x00, 
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  0x00, 0x00, 0x00, 0x00, 0x00, 0x00, 0x00, 0x00, 0x00, 0x00, 0x00, 0x00, 0x00, 0x00, 0x00, 0x00
};
 
const unsigned char sunny32 [] PROGMEM = {
 0xff, 0xff, 0xff, 0xff, 0xff, 0xff, 0xff, 0xff, 0xff, 0xfe, 0x7f, 0xff, 0xff, 0xfe, 0x7f, 0xff, 
0xff, 0xfe, 0x7f, 0xff, 0xff, 0xff, 0xff, 0xff, 0xfc, 0xff, 0xff, 0x3f, 0xfc, 0x7c, 0x3e, 0x3f, 
0xfe, 0x70, 0x0e, 0x7f, 0xff, 0xc7, 0xe3, 0xff, 0xff, 0x9f, 0xf9, 0xff, 0xff, 0xbf, 0xfd, 0xff, 
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0xff, 0xfe, 0x7f, 0xff, 0xff, 0xfe, 0x7f, 0xff, 0xff, 0xff, 0xff, 0xff, 0xff, 0xff, 0xff, 0xff
};
// 'rain_weather_3371', 32x32px
const unsigned char rainy32 [] PROGMEM = {
  0xff, 0xfe, 0x7f, 0xff, 0xff, 0xfe, 0x7f, 0xfd, 0xff, 0xfe, 0x7f, 0xf9, 0xcf, 0xfe, 0x7f, 0xf8, 
0xcf, 0xf0, 0x0f, 0xf8, 0x87, 0x80, 0x01, 0xf9, 0xce, 0x00, 0x00, 0x7f, 0xfc, 0x00, 0x00, 0x3f, 
0xf0, 0x00, 0x00, 0x0f, 0xf0, 0x00, 0x00, 0x0f, 0xe0, 0x00, 0x00, 0x07, 0xc0, 0x00, 0x00, 0x03, 
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0xff, 0x3e, 0x7f, 0xff, 0xff, 0x18, 0xff, 0xff, 0xff, 0x80, 0xff, 0xff, 0xff, 0xe3, 0xff, 0xff
};
// '3741357-cloud-cloudy-partly-cloudy-weather_108867', 32x32px
const unsigned char cloudy32 [] PROGMEM = {
 0xff, 0xff, 0xff, 0xff, 0xff, 0xff, 0xff, 0xff, 0xff, 0xff, 0xff, 0xff, 0xff, 0xff, 0xff, 0xff, 
0xff, 0x9f, 0xff, 0xff, 0xff, 0x9f, 0xff, 0xff, 0xff, 0x9f, 0xff, 0xff, 0xe7, 0xbe, 0x7f, 0xff, 
0xe3, 0xfc, 0x7f, 0xff, 0xf3, 0x04, 0xc0, 0x7f, 0xfe, 0x03, 0x00, 0x1f, 0xfc, 0xf0, 0x3f, 0x8f, 
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0xff, 0xff, 0xff, 0xff, 0xff, 0xff, 0xff, 0xff, 0xff, 0xff, 0xff, 0xff, 0xff, 0xff, 0xff, 0xff
};
// '3741358-christmas-cold-snow-weather_108876', 32x32px
const unsigned char snow32 [] PROGMEM = {
0xff, 0xff, 0xff, 0xff, 0xff, 0xff, 0xff, 0xff, 0xff, 0xfe, 0xff, 0xff, 0xff, 0xf6, 0x6f, 0xff, 
0xff, 0xf0, 0x0f, 0xff, 0xff, 0xf8, 0x1f, 0xff, 0xfc, 0xfc, 0x3f, 0x3f, 0xfc, 0x7e, 0x7e, 0x3f, 
0xfe, 0x3e, 0x7c, 0x7f, 0xff, 0x1e, 0x78, 0xff, 0xff, 0x8e, 0x71, 0xff, 0xff, 0xc6, 0x63, 0xff, 
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0xff, 0xf6, 0x6f, 0xff, 0xff, 0xff, 0xff, 0xff, 0xff, 0xff, 0xff, 0xff, 0xff, 0xff, 0xff, 0xff
};
// 'sleet32_application_climate_2877', 32x32px
const unsigned char sleet32 [] PROGMEM = {
  0xff, 0xff, 0x87, 0xff, 0xff, 0xfe, 0x00, 0xff, 0xff, 0xf8, 0x30, 0x7f, 0xff, 0xf8, 0xfc, 0x3f, 
  0xff, 0x81, 0xfe, 0x3f, 0xfe, 0x03, 0xff, 0x1f, 0xfc, 0x3f, 0xff, 0x9f, 0xfc, 0xff, 0xff, 0x87, 
  0xf8, 0xff, 0xff, 0x83, 0xe1, 0xff, 0xff, 0xf1, 0xc1, 0xff, 0xff, 0xf9, 0x8f, 0xff, 0xff, 0xf8, 
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  0xff, 0xf8, 0x7f, 0xff, 0xff, 0xf8, 0x3f, 0xff, 0xff, 0xf6, 0xbf, 0xff, 0xff, 0xfe, 0xff, 0xff
};
// 'day32_sleet_weather_icon_129754', 32x32px
const unsigned char rcd32 [] PROGMEM = {
  0xff, 0xff, 0xff, 0xff, 0xff, 0xff, 0xcf, 0xff, 0xff, 0xff, 0xcf, 0xff, 0xff, 0xff, 0xcf, 0xff, 
  0xff, 0xef, 0xcf, 0x9f, 0xff, 0xe7, 0xff, 0x1f, 0xff, 0xff, 0xff, 0x3f, 0xff, 0xff, 0x03, 0xff, 
  0xff, 0x80, 0x01, 0xff, 0xff, 0x00, 0x78, 0xff, 0xfe, 0x3c, 0x7c, 0xff, 0xfc, 0xfe, 0x3c, 0x63, 
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  0xff, 0xcf, 0xff, 0xff, 0xff, 0xcf, 0xff, 0xff, 0xff, 0xff, 0xff, 0xff, 0xff, 0xff, 0xff, 0xff
};
// '3741359-cloud-overcast32-weather_108879', 32x32px
const unsigned char overcast32 [] PROGMEM = {
  0xff, 0xff, 0xff, 0xff, 0xff, 0xff, 0xff, 0xff, 0xff, 0xff, 0xff, 0xff, 0xff, 0xff, 0xff, 0xff, 
  0xff, 0xff, 0xff, 0xff, 0xff, 0xfc, 0x0f, 0xff, 0xff, 0xf0, 0x03, 0xff, 0xff, 0xe1, 0xe1, 0xff, 
  0xfe, 0x07, 0xf0, 0xff, 0xf8, 0x07, 0x80, 0xff, 0xf9, 0xe6, 0x00, 0x3f, 0xf3, 0xf0, 0x7f, 0x1f, 
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  0xff, 0xff, 0xff, 0xff, 0xff, 0xff, 0xff, 0xff, 0xff, 0xff, 0xff, 0xff, 0xff, 0xff, 0xff, 0xff
};

const unsigned char heart [] PROGMEM = {
  0x00, 0x00, 0x00, 0x00, 0x00, 0x00, 0x00, 0x00, 0x00, 0x00, 0x00, 0x00, 0x00, 0x00, 0x00, 0x00, 
  0x07, 0xc0, 0x7c, 0x00, 0x1f, 0xf1, 0xff, 0x00, 0x38, 0x7b, 0xc3, 0x80, 0x70, 0x1f, 0x01, 0xc0, 
  0x60, 0x0e, 0x00, 0xc0, 0xc0, 0x04, 0x00, 0x60, 0xc0, 0x00, 0x00, 0x60, 0xc0, 0x00, 0x30, 0x60, 
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  0x00, 0x00, 0x00, 0x00, 0x00, 0x00, 0x00, 0x00, 0x00, 0x00, 0x00, 0x00, 0x00, 0x00, 0x00, 0x00
};


// 'morningfont', 32x15px
const unsigned char morningfont [] PROGMEM = {
  0x00, 0x00, 0x00, 0x00, 0x00, 0x00, 0x00, 0x00, 0x00, 0x00, 0x00, 0x00, 0x00, 0x00, 0x20, 0x00, 
  0x1e, 0x1f, 0x20, 0x00, 0x21, 0x04, 0x20, 0x00, 0x21, 0x04, 0xe0, 0x00, 0x21, 0x0e, 0x20, 0x00, 
  0x1e, 0x09, 0x20, 0x00, 0x0c, 0x10, 0x20, 0x00, 0x0c, 0x04, 0x00, 0x00, 0x7f, 0x84, 0x00, 0x00, 
  0x00, 0x07, 0xe0, 0x00, 0x00, 0x00, 0x00, 0x00, 0x00, 0x00, 0x00, 0x00
};

// 'afternoonfont', 32x15px
const unsigned char afternoonfont [] PROGMEM = {
  0x00, 0x00, 0x00, 0x00, 0x00, 0x00, 0x00, 0x00, 0x00, 0x00, 0x00, 0x00, 0x00, 0x03, 0x00, 0x00, 
  0x1e, 0x1f, 0xe0, 0x00, 0x21, 0x07, 0x80, 0x00, 0x21, 0x08, 0x40, 0x00, 0x21, 0x08, 0x40, 0x00, 
  0x1e, 0x07, 0x80, 0x00, 0x0c, 0x1f, 0xe0, 0x00, 0x0c, 0x03, 0x00, 0x00, 0x7f, 0x83, 0x00, 0x00, 
  0x00, 0x03, 0x00, 0x00, 0x00, 0x00, 0x00, 0x00, 0x00, 0x00, 0x00, 0x00
};
// 'hourfont', 14x15px
const unsigned char hourfont [] PROGMEM = {
  0x00, 0x00, 0x00, 0x00, 0x00, 0x00, 0x00, 0x00, 0x00, 0x80, 0x08, 0x80, 0x08, 0x80, 0x08, 0x80, 
  0x08, 0x80, 0x1c, 0x80, 0x36, 0x80, 0x22, 0x80, 0x00, 0x80, 0x00, 0x80, 0x00, 0x80
};
// 'Firdayfont', 40x15px
const unsigned char Firdayfont [] PROGMEM = {
  0x00, 0x00, 0x00, 0x00, 0x00, 0x00, 0x00, 0x00, 0x00, 0x00, 0x00, 0x00, 0x00, 0x00, 0x00, 0x00, 
  0x00, 0x00, 0x00, 0x00, 0x01, 0xf8, 0x3c, 0x1c, 0x80, 0x00, 0x08, 0x42, 0x22, 0x80, 0x00, 0x08, 
  0x42, 0x22, 0x80, 0x03, 0xfc, 0x42, 0x1c, 0x80, 0x00, 0x00, 0x3c, 0x00, 0x80, 0x01, 0xf8, 0x24, 
  0x0f, 0x80, 0x01, 0x08, 0x24, 0x0f, 0x80, 0x01, 0x08, 0xff, 0x08, 0x00, 0x01, 0xf8, 0x00, 0x0f, 
  0xc0, 0x00, 0x00, 0x00, 0x00, 0x00, 0x00, 0x00, 0x00, 0x00, 0x00
};
// 'Saturdayfont', 40x15px
const unsigned char Saturdayfont [] PROGMEM = {
  0x00, 0x00, 0x00, 0x00, 0x00, 0x00, 0x00, 0x00, 0x00, 0x00, 0x00, 0x00, 0x00, 0x00, 0x00, 0x00, 
  0x00, 0x00, 0x00, 0x00, 0x01, 0xf8, 0x3c, 0x1c, 0x80, 0x01, 0x00, 0x42, 0x22, 0x80, 0x01, 0xf8, 
  0x42, 0x22, 0x80, 0x01, 0x00, 0x42, 0x1c, 0x80, 0x01, 0xf8, 0x3c, 0x00, 0x80, 0x00, 0x60, 0x24, 
  0x0f, 0x80, 0x00, 0x60, 0x24, 0x0f, 0x80, 0x03, 0xfc, 0xff, 0x08, 0x00, 0x00, 0x00, 0x00, 0x0f, 
  0xc0, 0x00, 0x00, 0x00, 0x00, 0x00, 0x00, 0x00, 0x00, 0x00, 0x00
};
// 'Mondayfont', 40x15px
const unsigned char Mondayfont [] PROGMEM = {
  0x00, 0x00, 0x00, 0x00, 0x00, 0x00, 0x00, 0x00, 0x00, 0x00, 0x00, 0x00, 0x00, 0x00, 0x00, 0x01, 
  0xe8, 0x00, 0x00, 0x00, 0x02, 0x28, 0x3c, 0x1c, 0x80, 0x01, 0xe8, 0x42, 0x22, 0x80, 0x00, 0x08, 
  0x42, 0x22, 0x80, 0x03, 0xf8, 0x42, 0x1c, 0x80, 0x00, 0x98, 0x3c, 0x00, 0x80, 0x01, 0xf8, 0x24, 
  0x0f, 0x80, 0x00, 0x08, 0x24, 0x0f, 0x80, 0x01, 0xf8, 0xff, 0x08, 0x00, 0x01, 0xfc, 0x00, 0x0f, 
  0xc0, 0x00, 0x00, 0x00, 0x00, 0x00, 0x00, 0x00, 0x00, 0x00, 0x00
};
// 'Sundayfont', 40x15px
const unsigned char Sundayfont [] PROGMEM = {
  0x00, 0x00, 0x00, 0x00, 0x00, 0x00, 0x00, 0x00, 0x00, 0x00, 0x00, 0x00, 0x00, 0x00, 0x00, 0x00, 
  0x00, 0x00, 0x00, 0x00, 0x00, 0x00, 0x00, 0x00, 0x00, 0x07, 0x20, 0xf0, 0x72, 0x00, 0x08, 0xa1, 
  0x08, 0x8a, 0x00, 0x08, 0xa1, 0x08, 0x8a, 0x00, 0x07, 0x21, 0x08, 0x72, 0x00, 0x00, 0x20, 0xf0, 
  0x02, 0x00, 0x03, 0xe0, 0x90, 0x3e, 0x00, 0x03, 0xe0, 0x90, 0x3e, 0x00, 0x02, 0x03, 0xfc, 0x20, 
  0x00, 0x03, 0xf0, 0x00, 0x3f, 0x00, 0x00, 0x00, 0x00, 0x00, 0x00
};
// 'Tuesdayfont', 40x15px
const unsigned char Tuesdayfont [] PROGMEM = {
  0x00, 0x00, 0x00, 0x00, 0x00, 0x00, 0x00, 0x00, 0x00, 0x00, 0x00, 0x00, 0x00, 0x00, 0x00, 0x00, 
  0x88, 0x00, 0x00, 0x00, 0x03, 0xf8, 0x3c, 0x1c, 0x80, 0x01, 0xc8, 0x42, 0x22, 0x80, 0x02, 0x28, 
  0x42, 0x22, 0x80, 0x02, 0x2e, 0x42, 0x1c, 0x80, 0x01, 0xc8, 0x3c, 0x00, 0x80, 0x00, 0x88, 0x24, 
  0x0f, 0x80, 0x07, 0xf8, 0x24, 0x0f, 0x80, 0x00, 0x08, 0xff, 0x08, 0x00, 0x00, 0x00, 0x00, 0x0f, 
  0xc0, 0x00, 0x00, 0x00, 0x00, 0x00, 0x00, 0x00, 0x00, 0x00, 0x00
};
// 'Wednesdayfont', 40x15px
const unsigned char Wednesdayfont [] PROGMEM = {
  0x00, 0x00, 0x00, 0x00, 0x00, 0x00, 0x00, 0x00, 0x00, 0x00, 0x00, 0x00, 0x00, 0x00, 0x00, 0x00, 
  0x00, 0x00, 0x00, 0x00, 0x00, 0x60, 0x00, 0x00, 0x00, 0x00, 0x60, 0x3c, 0x1c, 0x80, 0x00, 0xf0, 
  0x42, 0x22, 0x80, 0x03, 0x0c, 0x42, 0x22, 0x80, 0x00, 0x00, 0x42, 0x1c, 0x80, 0x03, 0xfc, 0x3c, 
  0x00, 0x80, 0x00, 0x60, 0x24, 0x0f, 0x80, 0x00, 0x60, 0x24, 0x0f, 0x80, 0x00, 0x60, 0xff, 0x08, 
  0x00, 0x00, 0x60, 0x00, 0x0f, 0xc0, 0x00, 0x00, 0x00, 0x00, 0x00
};
// 'Tursdayfont', 40x15px
const unsigned char Tursdayfont [] PROGMEM = {
  0x00, 0x00, 0x00, 0x00, 0x00, 0x00, 0x00, 0x00, 0x00, 0x00, 0x00, 0x00, 0x00, 0x00, 0x00, 0x00, 
  0x00, 0x00, 0x00, 0x00, 0x00, 0x00, 0x00, 0x00, 0x00, 0x01, 0xf8, 0x3c, 0x1c, 0x80, 0x01, 0x08, 
  0x42, 0x22, 0x80, 0x01, 0xf8, 0x42, 0x22, 0x80, 0x00, 0x60, 0x42, 0x1c, 0x80, 0x03, 0xfc, 0x3c, 
  0x00, 0x80, 0x00, 0x00, 0x24, 0x0f, 0x80, 0x01, 0xf8, 0x24, 0x0f, 0x80, 0x00, 0x08, 0xff, 0x08, 
  0x00, 0x00, 0x08, 0x00, 0x0f, 0xc0, 0x00, 0x00, 0x00, 0x00, 0x00
};
// '1492719128-robot_83633', 32x32px
const unsigned char robot [] PROGMEM = {
  0x00, 0x00, 0x00, 0x00, 0x00, 0x00, 0x00, 0x00, 0x00, 0x00, 0x00, 0x00, 0x00, 0x00, 0x00, 0x00, 
  0x00, 0x03, 0xc0, 0x00, 0x00, 0x06, 0x60, 0x00, 0x00, 0x06, 0x60, 0x00, 0x00, 0x06, 0x60, 0x00, 
  0x00, 0x03, 0xc0, 0x00, 0x00, 0x01, 0x80, 0x00, 0x00, 0x01, 0x80, 0x00, 0x00, 0x7f, 0xfe, 0x00, 
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  0x00, 0x00, 0x00, 0x00, 0x00, 0x00, 0x00, 0x00, 0x00, 0x00, 0x00, 0x00, 0x00, 0x00, 0x00, 0x00
};
// 'error_119186', 32x32px
const unsigned char errorimg [] PROGMEM = {
  0x00, 0x0f, 0xf0, 0x00, 0x00, 0x7f, 0xfe, 0x00, 0x00, 0xff, 0xff, 0x00, 0x03, 0xff, 0xff, 0xc0, 
  0x07, 0xff, 0xff, 0xe0, 0x0f, 0xff, 0xff, 0xf0, 0x1f, 0xff, 0xff, 0xf8, 0x1f, 0xff, 0xff, 0xf8, 
  0x3f, 0xfe, 0x7f, 0xfc, 0x7f, 0xfc, 0x3f, 0xfc, 0x7f, 0xfc, 0x3f, 0xfe, 0x7f, 0xfc, 0x3f, 0xfe, 
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  0x03, 0xff, 0xff, 0xc0, 0x00, 0xff, 0xff, 0x00, 0x00, 0x3f, 0xfc, 0x00, 0x00, 0x0f, 0xf0, 0x00
};


// 'todayfont', 35x16px
const unsigned char todayfont [] PROGMEM = {
  0x00, 0x00, 0x00, 0x00, 0x00, 0x00, 0x00, 0x00, 0x00, 0x00, 0x00, 0x00, 0x00, 0x00, 0x00, 0x00, 
  0x00, 0x00, 0x00, 0x00, 0x00, 0x00, 0x40, 0x00, 0x00, 0x00, 0xf0, 0x40, 0x00, 0x00, 0x01, 0x08, 
  0x7e, 0x00, 0x00, 0x01, 0x08, 0x00, 0x00, 0x00, 0x01, 0x08, 0xff, 0x00, 0x00, 0x00, 0xf0, 0x00, 
  0x00, 0x00, 0x00, 0x60, 0x7e, 0x00, 0x00, 0x00, 0x60, 0x7e, 0x00, 0x00, 0x03, 0xfc, 0x40, 0x00, 
  0x00, 0x00, 0x00, 0x7e, 0x00, 0x00, 0x00, 0x00, 0x00, 0x00, 0x00, 0x00, 0x00, 0x00, 0x00, 0x00
};
// 'tommorowfont', 35x16px
const unsigned char tommorowfont [] PROGMEM = {
  0x00, 0x00, 0x00, 0x00, 0x00, 0x00, 0x00, 0x00, 0x00, 0x00, 0x00, 0x00, 0x00, 0x00, 0x00, 0x00, 
  0x14, 0x00, 0x00, 0x00, 0x02, 0x14, 0x72, 0x00, 0x00, 0x02, 0x14, 0x8a, 0x00, 0x00, 0x02, 0x14, 
  0x8a, 0x00, 0x00, 0x02, 0x1c, 0x72, 0x00, 0x00, 0x02, 0x14, 0x02, 0x00, 0x00, 0x03, 0xf4, 0x3e, 
  0x00, 0x00, 0x00, 0x14, 0x3e, 0x00, 0x00, 0x00, 0x14, 0x20, 0x00, 0x00, 0x00, 0x14, 0x3f, 0x00, 
  0x00, 0x00, 0x00, 0x00, 0x00, 0x00, 0x00, 0x00, 0x00, 0x00, 0x00, 0x00, 0x00, 0x00, 0x00, 0x00
};
// 'thedayatfont', 35x16px
const unsigned char thedayatfont [] PROGMEM = {
  0x00, 0x00, 0x00, 0x00, 0x00, 0x00, 0x00, 0x00, 0x00, 0x00, 0x00, 0x00, 0x00, 0x00, 0x00, 0x00, 
  0x00, 0x05, 0x00, 0x00, 0x01, 0xf8, 0xe5, 0x00, 0x00, 0x01, 0x08, 0x25, 0x00, 0x00, 0x01, 0x08, 
  0x25, 0x00, 0x00, 0x01, 0x08, 0xfd, 0x00, 0x00, 0x01, 0xf8, 0x85, 0x00, 0x00, 0x00, 0x60, 0x85, 
  0x00, 0x00, 0x00, 0x60, 0xf5, 0x00, 0x00, 0x03, 0xfc, 0x05, 0x00, 0x00, 0x00, 0x00, 0x05, 0x00, 
  0x00, 0x00, 0x00, 0x00, 0x00, 0x00, 0x00, 0x00, 0x00, 0x00, 0x00, 0x00, 0x00, 0x00, 0x00, 0x00
};

int counting=1;
IPAddress ip; 
#if (SH1106_LCDHEIGHT != 64)
#error("Height incorrect, please fix Adafruit_SH1106.h!");
#endif
void setup() {

  Serial.begin(115200);

  display.begin(SH1106_SWITCHCAPVCC, 0x3C); 
  pinMode(touchSensor, INPUT);

  
 display.clearDisplay();
 display.setTextColor(WHITE);

display.drawBitmap(0, 0, boot, 128, 64, WHITE);
display.display();
  WiFi.mode(WIFI_STA);

  WiFi.begin(ssid, password);

  Serial.println("\nConnecting to WiFi");
  delay(10000);
  while (WiFi.status() != WL_CONNECTED) {
     display.setTextSize(1);
    WiFi.disconnect(true);
    Serial.println("can't connect to WiFi");
    display.clearDisplay();
    display.setCursor(10,27);
    display.println("can't connect to AP");
    display.display();
    smartconfig();
  }
  display.setTextSize(2);
  display.setCursor(0,27);
  display.clearDisplay();
    display.println("connected!");
    
    ip=WiFi.localIP();
    Serial.println(ip);

    
    display.display();
    delay(1000);
  display.clearDisplay();
 
  configTime(timezone * 3600, 0, "pool.ntp.org", "time.nist.gov");

  Serial.println("\nWaiting for time");

  while (!time(NULL)) {

    Serial.print(".");

    delay(1000);

  }
  Serial.println("");
  
  while(counting){

   time_t now = time(NULL);
  struct tm* timeinfo;
  timeinfo=localtime(&now);
 c_result=computegapday(timeinfo->tm_year,timeinfo->tm_mon,timeinfo->tm_mday,2015,11,7);
 Serial.printf("%d일 사겼습니다.1\n", c_result);

  if(c_result>1000)
    counting=0;
delay(1000);
  }
  time_t now = time(NULL);
  struct tm* timeinfo;
  timeinfo=localtime(&now);
   if((timeinfo->tm_hour-3<5)){
    if((timeinfo->tm_hour-3<2)){
      getwheatherinfo(timeinfo->tm_year+1900,timeinfo->tm_mon+1,timeinfo->tm_mday-1,2);
      }else{
        getwheatherinfo(timeinfo->tm_year+1900,timeinfo->tm_mon+1,timeinfo->tm_mday,2);
        }
     getwheatherinfo(timeinfo->tm_year+1900,timeinfo->tm_mon+1,timeinfo->tm_mday-1,20);//0~2시사이니까 그전날 23시가 마지막
    }else {
         getwheatherinfo(timeinfo->tm_year+1900,timeinfo->tm_mon+1,timeinfo->tm_mday,2);
      if((timeinfo->tm_hour-3)%24%3==0)
              getwheatherinfo(timeinfo->tm_year+1900,timeinfo->tm_mon+1,timeinfo->tm_mday,(timeinfo->tm_hour-3+24)%24-1);
       if((timeinfo->tm_hour-3)%24%3==1)
               getwheatherinfo(timeinfo->tm_year+1900,timeinfo->tm_mon+1,timeinfo->tm_mday,(timeinfo->tm_hour-3+24)%24-2);
       if((timeinfo->tm_hour-3)%24%3==2)
               getwheatherinfo(timeinfo->tm_year+1900,timeinfo->tm_mon+1,timeinfo->tm_mday,(timeinfo->tm_hour-3+24)%24);
      }
}
void loop() {
  
  int touchValue = digitalRead(touchSensor);
  time_t now = time(NULL);
  struct tm* timeinfo;
  timeinfo=localtime(&now);
  display.clearDisplay();
  
   if((timeinfo->tm_hour==0)&&(timeinfo->tm_min==0)){
     c_result=computegapday(timeinfo->tm_year,timeinfo->tm_mon,timeinfo->tm_mday,2015,11,7);
     Serial.printf("사귄날짜 리셋\n");
   }
   if(((timeinfo->tm_hour==2&&timeinfo->tm_min==0)||(timeinfo->tm_hour==5&&timeinfo->tm_min==0)||(timeinfo->tm_hour==8&&timeinfo->tm_min==0)||(timeinfo->tm_hour==11&&timeinfo->tm_min==0)||(timeinfo->tm_hour==14&&timeinfo->tm_min==0)||(timeinfo->tm_hour==17&&timeinfo->tm_min==0)||(timeinfo->tm_hour==20&&timeinfo->tm_min==0)||(timeinfo->tm_hour==23&&timeinfo->tm_min==0))&&wloop==0){
         getwheatherinfo(timeinfo->tm_year+1900,timeinfo->tm_mon+1,timeinfo->tm_mday,(timeinfo->tm_hour-3+24)%24);  //한번 갱신하고 다시 실행 안되도록...
         wloop=1; //if안에 들어왔는지 체크 하고 위의 사용자 함수 실행후 나왔을때를 위해 체크
   }
    if(wloop!=0)
       wloopi++;
      if(wloopi==20){
       wloop=0;
       wloopi=0;
      }
  
   
  

//                   //내부 타이머

     Serial.println(count);

      if(count>=5)
      count=0;
      if(count==0){
         drawgettogetherday();
         drawtime(50,50);
         display.clearDisplay();
        }
      else if(count==1)
      {  
         display.clearDisplay();
        drawnowweather();
         }
       else if(count==2)
      {   
        display.clearDisplay();
        draw5weather(0,4);
      }
      else if(count==3){
         display.clearDisplay();
          draw5weather(4,4);
        }
        else{
           display.clearDisplay();
          draw5weather(8,4);
          }

       if (touchValue == HIGH){      // 터치됨
    Serial.println("TOUCHED");
      count++;
               } 
  else {                      //터치 안됨
    Serial.println("NOT TOUCHED");
  }
  delay(300);

   }

void smartconfig(){ //기존 공유기 연결 못할시..
   WiFi.beginSmartConfig();
   Serial.println("Waiting for SmartConfig.");

  while (!WiFi.smartConfigDone()) {

  delay(500);
  Serial.print(".");
  Serial.println("");
  Serial.println("SmartConfig received.");

  //Wait for WiFi to connect to AP
  Serial.println("Waiting for WiFi");
  while (WiFi.status() != WL_CONNECTED) {
    delay(500);
    Serial.print(".");
  }

  Serial.println("WiFi Connected.");

  Serial.print("IP Address: ");
  Serial.println(WiFi.localIP());
  
  }
  }

void getwheatherinfo(int year,int mon,int day,int hour){//날씨 정보를 획득합니다.
    WiFiClient client;

    HTTPClient http;

     char httptext[2][500];
     char s_mon[10];
     char s_day[10];
     char s_hour[10];
     int cnt=0;
     
   if(mon<10){
    sprintf(s_mon,"0%d",mon);
    }
   else{
    sprintf(s_mon,"%d",mon);
    }
    if(day<10){
      sprintf(s_day,"0%d",day);
    }
   else{
    sprintf(s_day,"%d",day);
    }
    if(hour<10){
      sprintf(s_hour,"0%d",hour);
    }
   else{
    sprintf(s_hour,"%d",hour);
    }
    A:
    Serial.print("[HTTP] begin...\n");
   
    sprintf(httptext[0],"http://apis.data.go.kr/1360000/VilageFcstInfoService/getVilageFcst?serviceKey=MYkMEd1Kx5PWDad4K0CUzdminh1l8NocDD0sSSijoqivkQ%%2BdiwlZsSTq2pWRqO5KlmCFOlI5tA%%2B90TZhGDTaeA%%3D%%3D&numOfRows=80&base_date=%d%s%s&base_time=%s00&nx=57&ny=121&dataType=JSON&pageNo=1",year,s_mon,s_day,s_hour);
    Serial.println(httptext[0]);
    sprintf(httptext[1],"http://apis.data.go.kr/1360000/VilageFcstInfoService/getVilageFcst?serviceKey=MYkMEd1Kx5PWDad4K0CUzdminh1l8NocDD0sSSijoqivkQ%%2BdiwlZsSTq2pWRqO5KlmCFOlI5tA%%2B90TZhGDTaeA%%3D%%3D&numOfRows=80&base_date=%d%s%s&base_time=%s00&nx=57&ny=121&dataType=JSON&pageNo=2",year,s_mon,s_day,s_hour);
    Serial.println(httptext[1]);
    
    if (http.begin(client,httptext[0])) {  // HTTP


      Serial.print("[HTTP] GET...\n");
      int httpCode = http.GET();

      // httpCode will be negative on error
      if (httpCode > 0) {
        // HTTP header has been send and Server response header has been handled
        Serial.printf("[HTTP] GET... code: %d\n", httpCode);

        // file found at server
        if (httpCode == HTTP_CODE_OK || httpCode == HTTP_CODE_MOVED_PERMANENTLY) {
          String payload = http.getString();
          Serial.println(payload);
         const size_t capacity=21000;
          Serial.println(capacity);
          DynamicJsonDocument doc(capacity);
          
  // Parse JSON object
  DeserializationError error = deserializeJson(doc, payload);
  if (error) {
    Serial.print(F("deserializeJson() failed: "));
    Serial.println(error.c_str());
    doc.capacity();
    errordisplay(error.c_str());
    goto A;
  }


  // Extract values
  Serial.println(F("Response:"));
  Serial.println(doc["response"]["body"]["numOfRows"].as<long>());
  
for(int i=0;i<doc["response"]["body"]["numOfRows"].as<long>();i++){

     if(strcmp("T3H",doc["response"]["body"]["items"]["item"][i]["category"].as<char *>())==0){
     stsv[cnt].nt=doc["response"]["body"]["items"]["item"][i]["fcstValue"].as<int>();
     stsv[cnt].fcstTime=doc["response"]["body"]["items"]["item"][i]["fcstTime"].as<int>()/100;
     stsv[cnt++].fcstDate=doc["response"]["body"]["items"]["item"][i]["fcstDate"].as<int>();
     if(cnt==8)
     break;
  }
    }
   cnt=0;
   for(int i=0;i<doc["response"]["body"]["numOfRows"].as<long>();i++){
     if(strcmp("PTY",doc["response"]["body"]["items"]["item"][i]["category"].as<char *>())==0){
      if(doc["response"]["body"]["items"]["item"][i]["fcstValue"].as<int>()==0){
           for(int i=0;i<doc["response"]["body"]["numOfRows"].as<long>();i++){
     if(strcmp("SKY",doc["response"]["body"]["items"]["item"][i]["category"].as<char *>())==0){
     stsv[cnt++].sky=doc["response"]["body"]["items"]["item"][i]["fcstValue"].as<int>();
     break;
         }
      } 
      }else{
     stsv[cnt++].sky=doc["response"]["body"]["items"]["item"][i]["fcstValue"].as<int>()+4; //sky와 중복을 피하기 위해
      }
  }
  if(cnt==8)
  break;
    } 

  if(hour==2){//최저기온+최고기온 갱신
    for(int i=0;i<doc["response"]["body"]["numOfRows"].as<long>();i++){
     if(strcmp("TMN",doc["response"]["body"]["items"]["item"][i]["category"].as<char *>())==0){
     tmn=doc["response"]["body"]["items"]["item"][i]["fcstValue"].as<double>()*10/10;
  }
   if(strcmp("TMX",doc["response"]["body"]["items"]["item"][i]["category"].as<char *>())==0){
     tmx=doc["response"]["body"]["items"]["item"][i]["fcstValue"].as<double>()*10/10;
     break;
  }
    } 
    }
  if(hour==5||hour==8||hour==11){//최고기온 갱신
    for(int i=0;i<doc["response"]["body"]["numOfRows"].as<long>();i++){
    if(strcmp("TMX",doc["response"]["body"]["items"]["item"][i]["category"].as<char *>())==0){
     tmx=doc["response"]["body"]["items"]["item"][i]["fcstValue"].as<double>()*10/10;
     break;
  }
    } 
  }
   doc.capacity();
        }else{
           Serial.printf("[HTTP] GET... failed, error: %s\n", http.errorToString(httpCode).c_str());
          Serial.printf("파일이 존재하지 않습니다.");
         errordisplay( http.errorToString(httpCode).c_str());
         goto A;
         
          }
      } else {
        Serial.printf("[HTTP] GET... failed, error: %s\n", http.errorToString(httpCode).c_str());
          errordisplay(http.errorToString(httpCode).c_str());
         goto A;
        
     
      }

      http.end();
    } else {
      Serial.printf("[HTTP} Unable to connect\n");
    }




   B:
    if (http.begin(client,httptext[1])) {  // HTTP


      Serial.print("[HTTP] GET...\n");
      int httpCode = http.GET();

      // httpCode will be negative on error
      if (httpCode > 0) {
        // HTTP header has been send and Server response header has been handled
        Serial.printf("[HTTP] GET... code: %d\n", httpCode);

        // file found at server
        if (httpCode == HTTP_CODE_OK || httpCode == HTTP_CODE_MOVED_PERMANENTLY) {
          String payload = http.getString();
          Serial.println(payload);
         const size_t capacity=21000;
          Serial.println(capacity);
          DynamicJsonDocument doc(capacity);
          
  // Parse JSON object
  DeserializationError error = deserializeJson(doc, payload);
  if (error) {
    Serial.print(F("deserializeJson() failed: "));
    Serial.println(error.c_str());
    doc.capacity();
    errordisplay(error.c_str());
    goto B;
  }


  // Extract values
  Serial.println(F("Response:"));
  Serial.println(doc["response"]["body"]["numOfRows"].as<long>());
  
for(int i=0;i<doc["response"]["body"]["numOfRows"].as<long>();i++){

     if(strcmp("T3H",doc["response"]["body"]["items"]["item"][i]["category"].as<char *>())==0){
     stsv[cnt].nt=doc["response"]["body"]["items"]["item"][i]["fcstValue"].as<int>();
     stsv[cnt].fcstTime=doc["response"]["body"]["items"]["item"][i]["fcstTime"].as<int>()/100;
     stsv[cnt++].fcstDate=doc["response"]["body"]["items"]["item"][i]["fcstDate"].as<int>();
     if(cnt==sizeof(stsv)/sizeof(stsv[0]))
     break;
  }
    }
   cnt=8;
   for(int i=0;i<doc["response"]["body"]["numOfRows"].as<long>();i++){
     if(strcmp("PTY",doc["response"]["body"]["items"]["item"][i]["category"].as<char *>())==0){
      if(doc["response"]["body"]["items"]["item"][i]["fcstValue"].as<int>()==0){
           for(int i=0;i<doc["response"]["body"]["numOfRows"].as<long>();i++){
     if(strcmp("SKY",doc["response"]["body"]["items"]["item"][i]["category"].as<char *>())==0){
     stsv[cnt++].sky=doc["response"]["body"]["items"]["item"][i]["fcstValue"].as<int>();
     break;
         }
      } 
      }else{
     stsv[cnt++].sky=doc["response"]["body"]["items"]["item"][i]["fcstValue"].as<int>()+4; //sky와 중복을 피하기 위해
      }
  }
  if(cnt==sizeof(stsv)/sizeof(stsv[0]))
  break;
    } 

 
   doc.capacity();
        }else{
           Serial.printf("[HTTP] GET... failed, error: %s\n", http.errorToString(httpCode).c_str());
          Serial.printf("파일이 존재하지 않습니다.");
         errordisplay( http.errorToString(httpCode).c_str());
         goto B;
         
          }
      } else {
        Serial.printf("[HTTP] GET... failed, error: %s\n", http.errorToString(httpCode).c_str());
          errordisplay(http.errorToString(httpCode).c_str());
         goto B;
        
     
      }

      http.end();
    } else {
      Serial.printf("[HTTP} Unable to connect\n");
    }
for(int i=0;i<sizeof(skyimgary)/sizeof(char *);i++){
  if(i==0){
  if(stsv[0].sky==1)
   *skyimgary[0]=sunny64;
  if(stsv[0].sky==3)
  *skyimgary[0]=cloudy64;
  if(stsv[0].sky==4)
  *skyimgary[0]=overcast64;
   if(stsv[0].sky==5)
  *skyimgary[0]=rainy64;
   if(stsv[0].sky==6)
  *skyimgary[0]=sleet64;
   if(stsv[0].sky==7)
  *skyimgary[0]=snow64;
  if(stsv[0].sky==8)
  *skyimgary[0]=rcd64;
  }
  else{
    if(stsv[i].sky==1)
   *skyimgary[i]=sunny32;
  if(stsv[i].sky==3)
  *skyimgary[i]=cloudy32;
  if(stsv[i].sky==4)
  *skyimgary[i]=overcast32;
   if(stsv[i].sky==5)
  *skyimgary[i]=rainy32;
   if(stsv[i].sky==6)
  *skyimgary[i]=sleet32;
   if(stsv[i].sky==7)
  *skyimgary[i]=snow32;
  if(stsv[i].sky==8)
  *skyimgary[i]=rcd32;
    }
  }
 
 delay(1000);
  }
void drawnowweather(){
  display.drawBitmap(0,0,*skyimgary[0],64,64, WHITE);
 // display.drawBitmap(100,10,c,32,32, WHITE);
  display.setCursor(70,10);
   display.setTextSize(3);
  display.print(stsv[0].nt);
  display.write(9);
  display.setCursor(70,40);
  display.setTextSize(1);
  display.print(tmn);
  display.print("/");
  display.print(tmx);
  printNdaytoHday(70,50);
  display.display();
  Serial.printf("날씨 %d,%d,%d,%d,%d,%d,%d,%d,%d,%d,%d,%d,%d\n",stsv[0].sky,stsv[1].sky,stsv[2].sky,stsv[3].sky,stsv[4].sky,stsv[5].sky,stsv[6].sky,stsv[7].sky,stsv[8].sky,stsv[9].sky,stsv[10].sky,stsv[11].sky,stsv[12].sky,stsv[13].nt);
  Serial.printf("기온 %d,%d,%d,%d,%d,%d,%d,%d,%d,%d,%d,%d,%d\n",stsv[0].nt,stsv[1].nt,stsv[2].nt,stsv[3].nt,stsv[4].nt,stsv[5].nt,stsv[6].nt,stsv[7].nt,stsv[8].nt,stsv[9].nt,stsv[10].nt,stsv[11].nt,stsv[12].nt,stsv[13].nt);
  Serial.printf("날짜 %d,%d,%d,%d,%d,%d,%d,%d,%d,%d,%d,%d,%d\n",stsv[0].fcstDate,stsv[1].fcstDate,stsv[2].fcstDate,stsv[3].fcstDate,stsv[4].fcstDate,stsv[5].fcstDate,stsv[6].fcstDate,stsv[7].fcstDate,stsv[8].fcstDate,stsv[9].fcstDate,stsv[10].fcstDate,stsv[11].fcstDate,stsv[12].fcstDate,stsv[13].fcstDate);
   Serial.printf("시간 %d,%d,%d,%d,%d,%d,%d,%d,%d,%d,%d,%d,%d\n",stsv[0].fcstTime,stsv[1].fcstTime,stsv[2].fcstTime,stsv[3].fcstTime,stsv[4].fcstTime,stsv[5].fcstTime,stsv[6].fcstTime,stsv[7].fcstTime,stsv[8].fcstTime,stsv[9].fcstTime,stsv[10].fcstTime,stsv[11].fcstTime,stsv[12].fcstTime,stsv[13].fcstTime);
  }  
void draw5weather(int starti,int csize){

  display.setTextSize(1);
      for(int j=0;j<csize;j++){
        display.drawBitmap(j*32,20,*skyimgary[starti+j+1],32,32, WHITE);
        display.setCursor(10+j*32,0);
        display.print(stsv[starti+j+1].nt);
        printtodayortommorow(j*32,6,starti+j+1);
        display.write(9);
        display.setCursor(10+j*32,56);
        display.print(stsv[starti+j+1].fcstTime);
        display.drawBitmap(22+j*32,50,hourfont,14,15, WHITE);
        }
      
      display.display();
    
      
  }
  
void drawgettogetherday(){
   display.setCursor(40,25);
   display.setTextSize(2);
   time_t now = time(NULL);
  struct tm* timeinfo;
  timeinfo=localtime(&now);
  display.print(c_result);
 Serial.printf("%d일 사겼습니다.2\n", c_result);
  display.drawBitmap(0,16, heart, 32, 32, WHITE);
 display.drawBitmap(96,16, heart, 32, 32, WHITE);
 
  }
  
void drawtime(int x,int y){
  char buffer[80];
   display.setCursor(x,y);
    display.setTextSize(1);
   time_t now = time(NULL);
  struct tm* timeinfo;
  timeinfo=localtime(&now);
   if(timeinfo->tm_hour<13){
    display.drawBitmap(26,45,morningfont,32,15, WHITE);
    strftime(buffer,80,"%I:%M:%S",timeinfo);
    }else{
        display.drawBitmap(26,45,afternoonfont,32,15, WHITE);
         strftime(buffer,80,"%I:%M:%S",timeinfo);
      }


  display.printf(buffer);
  display.display();
  }

  
int computegapday(int year,int mon,int day,int startyear , int startmonth ,int startday){
  
  int y=year;
  int m=mon+1;
  int d=day;                                                //현재 년월일
  int t_sum = 0;                                        //살아온날의 합
  int i;

 

  //살아온 날의 합 계산
  for (i = startyear-1900; i < y; i++)
  {
    t_sum += date_sum(i, 12, 31);
  }
  t_sum += date_sum(y, m, d);                        //현재까지 날짜 더함
  t_sum -= date_sum(startyear-1900,startmonth,startday-1);        //생년1월1일부터 태어난 날까지 합을 빼줌

  

   return t_sum;
  }
  
int test_leap_year(int year){
  if (year % 4 == 0) {
    if (year % 100 == 0) {
      if (year % 400 == 0)
        return 0;                        //윤년
      else
        return 1;
    }
    else
      return 0;                                //윤년
  }
  else
    return 1;                                        //평년        
}

int date_sum(int y, int m, int d)
{
  int sum = 0;
  int i;
  int test = test_leap_year(y);

  for (i = 1; i < m; i++)
  {
    if (i == 1 || i == 3 || i == 5 || i == 7 || i == 8 || i == 10 || i == 12)
      sum += 31;
    else if (i == 2)
    {
      if (test == 1)                        //해당 연도가 평년일 경우
        sum += 28;
      else
        sum += 29;                //해당 연도가 윤년일 경우
    }
    else
      sum += 30;
  }
  sum += d;                                                //오늘 날짜 더함
  return sum;
}
void errordisplay(String error){
          display.clearDisplay();
          display.setTextSize(1);
          display.setCursor(0,0);
          display.print("Error:");
          display.print("<");
          display.print(error);
          display.println(">");   
          display.println("Contact:010-8482-4720");
          display.drawBitmap(10,32,errorimg,32,32, WHITE);
          display.drawBitmap(48,32,robot,32,32, WHITE);
          display.drawBitmap(86,32,errorimg,32,32, WHITE);
          display.display();
          delay(3000);
          display.clearDisplay();
          
  }

 
void printNdaytoHday(int x,int y){ //숫자 날짜를 한글로 출력하는 함수
   time_t now = time(NULL);
  struct tm* timeinfo;
  timeinfo=localtime(&now);
  switch(timeinfo->tm_wday){
    case 0:
        display.drawBitmap(x,y,Sundayfont,40,15, WHITE);
    break;
    
    case 1:
        display.drawBitmap(x,y,Mondayfont,40,15, WHITE);
    break;
    
    case 2:
        display.drawBitmap(x,y,Tuesdayfont,40,15, WHITE);
    break;
    
    case 3:
        display.drawBitmap(x,y,Wednesdayfont,40,15, WHITE);
    break;
    
    case 4:
         display.drawBitmap(x,y,Tursdayfont,40,15, WHITE);
    break;
    
    case 5:
            display.drawBitmap(x,y,Firdayfont,40,15, WHITE);
    break;
    
    default:
            display.drawBitmap(x,y,Saturdayfont,40,15, WHITE);
    break;
    
    
    }
  }
  void printtodayortommorow(int x,int y,int i){ //오늘or내일인지 한글 화면표시
   time_t now = time(NULL);
  struct tm* timeinfo;
  timeinfo=localtime(&now);
  
 int gapday=computegapday(stsv[i].fcstDate/10000-1900,stsv[i].fcstDate%10000/100-1,stsv[i].fcstDate%100,timeinfo->tm_year+1900,timeinfo->tm_mon+1,timeinfo->tm_mday);
 
   Serial.println(gapday);
  if(gapday==1){//오늘
     display.drawBitmap(x,y,todayfont,35,16, WHITE);
    }else if(gapday==2){//내일 같지 않거나 다음달 1일..
        display.drawBitmap(x,y,tommorowfont,35,16, WHITE);
        }else{ //모레
        display.drawBitmap(x,y,thedayatfont,35,16, WHITE);
          }
    
  }
