#include <SPI.h>
#include <Wire.h>
#include <Adafruit_GFX.h>
#include <Adafruit_SSD1306.h>
#include <Arduino.h>
#include <string.h>
#include <ESP8266WiFi.h>
#include <ESP8266WiFiMulti.h>
#include <time.h>
#include <ArduinoJson.h>
#include <ESP8266HTTPClient.h>
#include <WiFiClient.h>


#define SCREEN_WIDTH 128 // OLED display width, in pixels
#define SCREEN_HEIGHT 64 // OLED display height, in pixels
// Declaration for SSD1306 display connected using software SPI (default case):
#define OLED_MOSI   12
#define OLED_CLK   13
#define OLED_DC    4
#define OLED_CS    5
#define OLED_RESET 14
Adafruit_SSD1306 display(SCREEN_WIDTH, SCREEN_HEIGHT,
  OLED_MOSI, OLED_CLK, OLED_DC, OLED_RESET, OLED_CS);

#define NUMFLAKES     10 // Number of snowflakes in the animation example

#define LOGO_HEIGHT   16
#define LOGO_WIDTH    16  

const char* ssid = "U+Net16C5";
const char* password = "1C18047287";

int nt[6]={0,0,0,0,0,0}; //기온
int tmn=0; //최저기온
int tmx=0; //최고기온
int sky[6]={0,0,0,0,0,0}; //하늘상태,강수량 포함.
int wloop=0; 
int wloopi=0; 
const unsigned char *skyimg0=NULL;
const unsigned char *skyimg1=NULL;
const unsigned char *skyimg2=NULL;
const unsigned char *skyimg3=NULL;
const unsigned char *skyimg4=NULL;
const unsigned char *skyimg5=NULL;

const unsigned char** skyimgary[6]={&skyimg0,&skyimg1,&skyimg2,&skyimg3,&skyimg4,&skyimg5};

int timezone = 9;

int c_result=0;



const unsigned char boot [] PROGMEM = {
0xff, 0xff, 0xff, 0xff, 0xff, 0xff, 0xff, 0xff, 0xff, 0xff, 0xff, 0xff, 0xff, 0xff, 0xff, 0xff, 
  0xff, 0xff, 0xff, 0xff, 0xff, 0xff, 0xff, 0xff, 0xff, 0xff, 0xff, 0xff, 0xff, 0xff, 0xff, 0xff, 
  0xff, 0xff, 0xff, 0xff, 0xff, 0xff, 0xff, 0xff, 0xff, 0xff, 0xf8, 0x00, 0x7f, 0xff, 0xff, 0xff, 
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  0xff, 0xff, 0xff, 0xff, 0xff, 0xff, 0xff, 0xff, 0xff, 0xff, 0xff, 0xff, 0xff, 0xff, 0xe7, 0xff
 };
// '3741356-sun-sunny-weather64_108871', 64x64px
const unsigned char sunny64 [] PROGMEM = {
  0xff, 0xff, 0xff, 0xff, 0xff, 0xff, 0xff, 0xff, 0xff, 0xff, 0xff, 0xff, 0xff, 0xff, 0xff, 0xff, 
  0xff, 0xff, 0xff, 0xfc, 0x3f, 0xff, 0xff, 0xff, 0xff, 0xff, 0xff, 0xfc, 0x3f, 0xff, 0xff, 0xff, 
  0xff, 0xff, 0xff, 0xfc, 0x3f, 0xff, 0xff, 0xff, 0xff, 0xff, 0xff, 0xfc, 0x3f, 0xff, 0xff, 0xff, 
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  0xff, 0xff, 0xff, 0xff, 0xff, 0xff, 0xff, 0xff, 0xff, 0xff, 0xff, 0xff, 0xff, 0xff, 0xff, 0xff
};
// '3741357-cloud-cloudy-partly-cloudy64-weather_108867', 64x64px
const unsigned char cloudy64[] PROGMEM = {
  0xff, 0xff, 0xff, 0xff, 0xff, 0xff, 0xff, 0xff, 0xff, 0xff, 0xff, 0xff, 0xff, 0xff, 0xff, 0xff, 
  0xff, 0xff, 0xff, 0xff, 0xff, 0xff, 0xff, 0xff, 0xff, 0xff, 0xff, 0xff, 0xff, 0xff, 0xff, 0xff, 
  0xff, 0xff, 0xff, 0xff, 0xff, 0xff, 0xff, 0xff, 0xff, 0xff, 0xff, 0xff, 0xff, 0xff, 0xff, 0xff, 
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  0xff, 0xff, 0xff, 0xff, 0xff, 0xff, 0xff, 0xff, 0xff, 0xff, 0xff, 0xff, 0xff, 0xff, 0xff, 0xff
};
// '3741359-cloud-overcast-weather_108879', 64x64px
const unsigned char overcast64 [] PROGMEM = {
  0xff, 0xff, 0xff, 0xff, 0xff, 0xff, 0xff, 0xff, 0xff, 0xff, 0xff, 0xff, 0xff, 0xff, 0xff, 0xff, 
  0xff, 0xff, 0xff, 0xff, 0xff, 0xff, 0xff, 0xff, 0xff, 0xff, 0xff, 0xff, 0xff, 0xff, 0xff, 0xff, 
  0xff, 0xff, 0xff, 0xff, 0xff, 0xff, 0xff, 0xff, 0xff, 0xff, 0xff, 0xff, 0xff, 0xff, 0xff, 0xff, 
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  0xff, 0xff, 0xff, 0xff, 0xff, 0xff, 0xff, 0xff, 0xff, 0xff, 0xff, 0xff, 0xff, 0xff, 0xff, 0xff
};
// 'rain_weather64_3371', 64x64px
const unsigned char rainy64 [] PROGMEM = {
  0xff, 0xff, 0xff, 0xfc, 0x3f, 0xff, 0xff, 0xff, 0xff, 0xff, 0xff, 0xf8, 0x1f, 0xff, 0xff, 0xf7, 
  0xff, 0xff, 0xff, 0xf8, 0x1f, 0xff, 0xff, 0xe7, 0xff, 0xff, 0xff, 0xf8, 0x1f, 0xff, 0xff, 0xe3, 
  0xf9, 0xff, 0xff, 0xf8, 0x1f, 0xff, 0xff, 0xc1, 0xf8, 0xff, 0xff, 0xf8, 0x1f, 0xff, 0xff, 0x81, 
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  0xff, 0xff, 0xe0, 0x03, 0xff, 0xff, 0xff, 0xff, 0xff, 0xff, 0xf8, 0x07, 0xff, 0xff, 0xff, 0xff
};

// 'sleet_application_climate64_2877', 64x64px
const unsigned char sleet64 [] PROGMEM = {
  0xff, 0xff, 0xff, 0xff, 0x80, 0x1f, 0xff, 0xff, 0xff, 0xff, 0xff, 0xfe, 0x00, 0x03, 0xff, 0xff, 
  0xff, 0xff, 0xff, 0xf8, 0x00, 0x01, 0xff, 0xff, 0xff, 0xff, 0xff, 0xf0, 0x00, 0x00, 0x7f, 0xff, 
  0xff, 0xff, 0xff, 0xe0, 0x00, 0x00, 0x3f, 0xff, 0xff, 0xff, 0xff, 0xc0, 0x0f, 0x00, 0x1f, 0xff, 
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  0xff, 0xff, 0xff, 0xf8, 0xff, 0xff, 0xff, 0xff, 0xff, 0xff, 0xff, 0xf8, 0xff, 0xff, 0xff, 0xff
};

// '3741358-christmas-cold-snow64-weather_108876', 64x64px
const unsigned char snow64 [] PROGMEM = {
  0xff, 0xff, 0xff, 0xff, 0xff, 0xff, 0xff, 0xff, 0xff, 0xff, 0xff, 0xff, 0xff, 0xff, 0xff, 0xff, 
  0xff, 0xff, 0xff, 0xff, 0xff, 0xff, 0xff, 0xff, 0xff, 0xff, 0xff, 0xfe, 0x7f, 0xff, 0xff, 0xff, 
  0xff, 0xff, 0xff, 0xfc, 0x3f, 0xff, 0xff, 0xff, 0xff, 0xff, 0xfe, 0x38, 0x1c, 0x7f, 0xff, 0xff, 
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  0xff, 0xff, 0xff, 0xff, 0xff, 0xff, 0xff, 0xff, 0xff, 0xff, 0xff, 0xff, 0xff, 0xff, 0xff, 0xff
};
// 'sunandcloudwithrain64_87433', 64x64px
const unsigned char rcd64 [] PROGMEM = {
  0xff, 0xff, 0xff, 0xff, 0xff, 0xff, 0xff, 0xff, 0xff, 0xff, 0xff, 0xff, 0xfe, 0x1f, 0xff, 0xff, 
  0xff, 0xff, 0xff, 0xff, 0xfe, 0x1f, 0xff, 0xff, 0xff, 0xff, 0xff, 0xff, 0xfe, 0x1f, 0xff, 0xff, 
  0xff, 0xff, 0xff, 0xff, 0xfe, 0x1f, 0xff, 0xff, 0xff, 0xff, 0xff, 0xff, 0xfe, 0x1f, 0xff, 0xff, 
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  0xff, 0xff, 0x8f, 0xff, 0xff, 0xff, 0xff, 0xff, 0xff, 0xff, 0xff, 0xff, 0xff, 0xff, 0xff, 0xff
};

const unsigned char c [] PROGMEM = {
  0x00, 0x00, 0x00, 0x00, 0x00, 0x00, 0x00, 0x00, 0x00, 0x00, 0x00, 0x00, 0x00, 0x00, 0x00, 0x00, 
  0x00, 0x00, 0x00, 0x00, 0x00, 0x00, 0x00, 0x00, 0x00, 0x00, 0x00, 0x00, 0x00, 0x00, 0x00, 0x00, 
  0x03, 0xc0, 0x7f, 0x80, 0x02, 0x61, 0xff, 0x80, 0x02, 0x23, 0xfb, 0x80, 0x03, 0x47, 0xc0, 0x00, 
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  0x00, 0x00, 0x00, 0x00, 0x00, 0x00, 0x00, 0x00, 0x00, 0x00, 0x00, 0x00, 0x00, 0x00, 0x00, 0x00
};
 
const unsigned char sunny32 [] PROGMEM = {
 0xff, 0xff, 0xff, 0xff, 0xff, 0xff, 0xff, 0xff, 0xff, 0xfe, 0x7f, 0xff, 0xff, 0xfe, 0x7f, 0xff, 
0xff, 0xfe, 0x7f, 0xff, 0xff, 0xff, 0xff, 0xff, 0xfc, 0xff, 0xff, 0x3f, 0xfc, 0x7c, 0x3e, 0x3f, 
0xfe, 0x70, 0x0e, 0x7f, 0xff, 0xc7, 0xe3, 0xff, 0xff, 0x9f, 0xf9, 0xff, 0xff, 0xbf, 0xfd, 0xff, 
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0xff, 0xfe, 0x7f, 0xff, 0xff, 0xfe, 0x7f, 0xff, 0xff, 0xff, 0xff, 0xff, 0xff, 0xff, 0xff, 0xff
};
// 'rain_weather_3371', 32x32px
const unsigned char rainy32 [] PROGMEM = {
  0xff, 0xfe, 0x7f, 0xff, 0xff, 0xfe, 0x7f, 0xfd, 0xff, 0xfe, 0x7f, 0xf9, 0xcf, 0xfe, 0x7f, 0xf8, 
0xcf, 0xf0, 0x0f, 0xf8, 0x87, 0x80, 0x01, 0xf9, 0xce, 0x00, 0x00, 0x7f, 0xfc, 0x00, 0x00, 0x3f, 
0xf0, 0x00, 0x00, 0x0f, 0xf0, 0x00, 0x00, 0x0f, 0xe0, 0x00, 0x00, 0x07, 0xc0, 0x00, 0x00, 0x03, 
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0xff, 0x3e, 0x7f, 0xff, 0xff, 0x18, 0xff, 0xff, 0xff, 0x80, 0xff, 0xff, 0xff, 0xe3, 0xff, 0xff
};
// '3741357-cloud-cloudy-partly-cloudy-weather_108867', 32x32px
const unsigned char cloudy32 [] PROGMEM = {
 0xff, 0xff, 0xff, 0xff, 0xff, 0xff, 0xff, 0xff, 0xff, 0xff, 0xff, 0xff, 0xff, 0xff, 0xff, 0xff, 
0xff, 0x9f, 0xff, 0xff, 0xff, 0x9f, 0xff, 0xff, 0xff, 0x9f, 0xff, 0xff, 0xe7, 0xbe, 0x7f, 0xff, 
0xe3, 0xfc, 0x7f, 0xff, 0xf3, 0x04, 0xc0, 0x7f, 0xfe, 0x03, 0x00, 0x1f, 0xfc, 0xf0, 0x3f, 0x8f, 
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0xff, 0xff, 0xff, 0xff, 0xff, 0xff, 0xff, 0xff, 0xff, 0xff, 0xff, 0xff, 0xff, 0xff, 0xff, 0xff
};
// '3741358-christmas-cold-snow-weather_108876', 32x32px
const unsigned char snow32 [] PROGMEM = {
0xff, 0xff, 0xff, 0xff, 0xff, 0xff, 0xff, 0xff, 0xff, 0xfe, 0xff, 0xff, 0xff, 0xf6, 0x6f, 0xff, 
0xff, 0xf0, 0x0f, 0xff, 0xff, 0xf8, 0x1f, 0xff, 0xfc, 0xfc, 0x3f, 0x3f, 0xfc, 0x7e, 0x7e, 0x3f, 
0xfe, 0x3e, 0x7c, 0x7f, 0xff, 0x1e, 0x78, 0xff, 0xff, 0x8e, 0x71, 0xff, 0xff, 0xc6, 0x63, 0xff, 
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0xff, 0xf6, 0x6f, 0xff, 0xff, 0xff, 0xff, 0xff, 0xff, 0xff, 0xff, 0xff, 0xff, 0xff, 0xff, 0xff
};
// 'sleet32_application_climate_2877', 32x32px
const unsigned char sleet32 [] PROGMEM = {
  0xff, 0xff, 0x87, 0xff, 0xff, 0xfe, 0x00, 0xff, 0xff, 0xf8, 0x30, 0x7f, 0xff, 0xf8, 0xfc, 0x3f, 
  0xff, 0x81, 0xfe, 0x3f, 0xfe, 0x03, 0xff, 0x1f, 0xfc, 0x3f, 0xff, 0x9f, 0xfc, 0xff, 0xff, 0x87, 
  0xf8, 0xff, 0xff, 0x83, 0xe1, 0xff, 0xff, 0xf1, 0xc1, 0xff, 0xff, 0xf9, 0x8f, 0xff, 0xff, 0xf8, 
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  0xff, 0xf8, 0x7f, 0xff, 0xff, 0xf8, 0x3f, 0xff, 0xff, 0xf6, 0xbf, 0xff, 0xff, 0xfe, 0xff, 0xff
};
// 'day32_sleet_weather_icon_129754', 32x32px
const unsigned char rcd32 [] PROGMEM = {
  0xff, 0xff, 0xff, 0xff, 0xff, 0xff, 0xcf, 0xff, 0xff, 0xff, 0xcf, 0xff, 0xff, 0xff, 0xcf, 0xff, 
  0xff, 0xef, 0xcf, 0x9f, 0xff, 0xe7, 0xff, 0x1f, 0xff, 0xff, 0xff, 0x3f, 0xff, 0xff, 0x03, 0xff, 
  0xff, 0x80, 0x01, 0xff, 0xff, 0x00, 0x78, 0xff, 0xfe, 0x3c, 0x7c, 0xff, 0xfc, 0xfe, 0x3c, 0x63, 
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  0xff, 0xcf, 0xff, 0xff, 0xff, 0xcf, 0xff, 0xff, 0xff, 0xff, 0xff, 0xff, 0xff, 0xff, 0xff, 0xff
};
// '3741359-cloud-overcast32-weather_108879', 32x32px
const unsigned char overcast32 [] PROGMEM = {
  0xff, 0xff, 0xff, 0xff, 0xff, 0xff, 0xff, 0xff, 0xff, 0xff, 0xff, 0xff, 0xff, 0xff, 0xff, 0xff, 
  0xff, 0xff, 0xff, 0xff, 0xff, 0xfc, 0x0f, 0xff, 0xff, 0xf0, 0x03, 0xff, 0xff, 0xe1, 0xe1, 0xff, 
  0xfe, 0x07, 0xf0, 0xff, 0xf8, 0x07, 0x80, 0xff, 0xf9, 0xe6, 0x00, 0x3f, 0xf3, 0xf0, 0x7f, 0x1f, 
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  0xff, 0xff, 0xff, 0xff, 0xff, 0xff, 0xff, 0xff, 0xff, 0xff, 0xff, 0xff, 0xff, 0xff, 0xff, 0xff
};

const unsigned char heart [] PROGMEM = {
  0x00, 0x00, 0x00, 0x00, 0x00, 0x00, 0x00, 0x00, 0x00, 0x00, 0x00, 0x00, 0x00, 0x00, 0x00, 0x00, 
  0x07, 0xc0, 0x7c, 0x00, 0x1f, 0xf1, 0xff, 0x00, 0x38, 0x7b, 0xc3, 0x80, 0x70, 0x1f, 0x01, 0xc0, 
  0x60, 0x0e, 0x00, 0xc0, 0xc0, 0x04, 0x00, 0x60, 0xc0, 0x00, 0x00, 0x60, 0xc0, 0x00, 0x30, 0x60, 
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  0x00, 0x00, 0x00, 0x00, 0x00, 0x00, 0x00, 0x00, 0x00, 0x00, 0x00, 0x00, 0x00, 0x00, 0x00, 0x00
};


// 'morningfont', 32x15px
const unsigned char morningfont [] PROGMEM = {
  0x00, 0x00, 0x00, 0x00, 0x00, 0x00, 0x00, 0x00, 0x00, 0x00, 0x00, 0x00, 0x00, 0x00, 0x20, 0x00, 
  0x1e, 0x1f, 0x20, 0x00, 0x21, 0x04, 0x20, 0x00, 0x21, 0x04, 0xe0, 0x00, 0x21, 0x0e, 0x20, 0x00, 
  0x1e, 0x09, 0x20, 0x00, 0x0c, 0x10, 0x20, 0x00, 0x0c, 0x04, 0x00, 0x00, 0x7f, 0x84, 0x00, 0x00, 
  0x00, 0x07, 0xe0, 0x00, 0x00, 0x00, 0x00, 0x00, 0x00, 0x00, 0x00, 0x00
};

// 'afternoonfont', 32x15px
const unsigned char afternoonfont [] PROGMEM = {
  0x00, 0x00, 0x00, 0x00, 0x00, 0x00, 0x00, 0x00, 0x00, 0x00, 0x00, 0x00, 0x00, 0x03, 0x00, 0x00, 
  0x1e, 0x1f, 0xe0, 0x00, 0x21, 0x07, 0x80, 0x00, 0x21, 0x08, 0x40, 0x00, 0x21, 0x08, 0x40, 0x00, 
  0x1e, 0x07, 0x80, 0x00, 0x0c, 0x1f, 0xe0, 0x00, 0x0c, 0x03, 0x00, 0x00, 0x7f, 0x83, 0x00, 0x00, 
  0x00, 0x03, 0x00, 0x00, 0x00, 0x00, 0x00, 0x00, 0x00, 0x00, 0x00, 0x00
};
// 'hourfont', 14x15px
const unsigned char hourfont [] PROGMEM = {
  0x00, 0x00, 0x00, 0x00, 0x00, 0x00, 0x00, 0x00, 0x00, 0x80, 0x08, 0x80, 0x08, 0x80, 0x08, 0x80, 
  0x08, 0x80, 0x1c, 0x80, 0x36, 0x80, 0x22, 0x80, 0x00, 0x80, 0x00, 0x80, 0x00, 0x80
};

int counting=1;
IPAddress ip; 

void setup() {

  Serial.begin(115200);

  // SSD1306_SWITCHCAPVCC = generate display voltage from 3.3V internally
  if(!display.begin(SSD1306_SWITCHCAPVCC)) {
    Serial.println(F("SSD1306 allocation failed"));
    for(;;); // Don't proceed, loop forever
  }
 display.clearDisplay();
 display.setTextColor(WHITE);

display.drawBitmap(0, 0, boot, 128, 64, WHITE);
display.display();
  WiFi.mode(WIFI_STA);

  WiFi.begin(ssid, password);

  Serial.println("\nConnecting to WiFi");
  delay(10000);
  while (WiFi.status() != WL_CONNECTED) {
     display.setTextSize(1);
    WiFi.disconnect(true);
    Serial.println("can't connect to WiFi");
    display.clearDisplay();
    display.setCursor(10,27);
    display.println("can't connect to AP");
    display.display();
    smartconfig();
  }
  display.setTextSize(2);
  display.setCursor(0,27);
  display.clearDisplay();
    display.println("connected!");
    
    ip=WiFi.localIP();
    Serial.println(ip);

    
    display.display();
    delay(1000);
  display.clearDisplay();
 
  configTime(timezone * 3600, 0, "pool.ntp.org", "time.nist.gov");

  Serial.println("\nWaiting for time");

  while (!time(NULL)) {

    Serial.print(".");

    delay(1000);

  }
  Serial.println("");
  
  while(counting){
    display.clearDisplay();
    display.setCursor(40,25);
   time_t now = time(NULL);
  struct tm* timeinfo;
  timeinfo=localtime(&now);
 countgettogether(timeinfo->tm_year,timeinfo->tm_mon,timeinfo->tm_mday);
 Serial.printf("%d일 사겼습니다.1\n", c_result);
 display.drawBitmap(0,16, heart, 32, 32, WHITE);
 display.drawBitmap(96,16, heart, 32, 32, WHITE);
  display.print(c_result);
  if(c_result>1000)
    counting=0;
delay(1000);
  }
  time_t now = time(NULL);
  struct tm* timeinfo;
  timeinfo=localtime(&now);
   display.display();
   if((timeinfo->tm_hour-3<5)){
    if((timeinfo->tm_hour-3<2)){
      getwheatherinfo(timeinfo->tm_year+1900,timeinfo->tm_mon+1,timeinfo->tm_mday-1,2);
      }else{
        getwheatherinfo(timeinfo->tm_year+1900,timeinfo->tm_mon+1,timeinfo->tm_mday,2);
        }
     getwheatherinfo(timeinfo->tm_year+1900,timeinfo->tm_mon+1,timeinfo->tm_mday-1,20);//0~2시사이니까 그전날 23시가 마지막
    }else {
         getwheatherinfo(timeinfo->tm_year+1900,timeinfo->tm_mon+1,timeinfo->tm_mday,2);
      if((timeinfo->tm_hour-3)%24%3==0)
              getwheatherinfo(timeinfo->tm_year+1900,timeinfo->tm_mon+1,timeinfo->tm_mday,(timeinfo->tm_hour-3+24)%24-1);
       if((timeinfo->tm_hour-3)%24%3==1)
               getwheatherinfo(timeinfo->tm_year+1900,timeinfo->tm_mon+1,timeinfo->tm_mday,(timeinfo->tm_hour-3+24)%24-2);
       if((timeinfo->tm_hour-3)%24%3==2)
               getwheatherinfo(timeinfo->tm_year+1900,timeinfo->tm_mon+1,timeinfo->tm_mday,(timeinfo->tm_hour-3+24)%24);
      }
}
void loop() {
//  getwheatherinfo();
  time_t now = time(NULL);
  struct tm* timeinfo;
  timeinfo=localtime(&now);
  display.clearDisplay();
  
   if((timeinfo->tm_hour==0)&&(timeinfo->tm_min==0)){
     countgettogether(timeinfo->tm_year,timeinfo->tm_mon,timeinfo->tm_mday);
     Serial.printf("사귄날짜 리셋\n");
   }
   if(((timeinfo->tm_hour==2&&timeinfo->tm_min==0)||(timeinfo->tm_hour==5&&timeinfo->tm_min==0)||(timeinfo->tm_hour==8&&timeinfo->tm_min==0)||(timeinfo->tm_hour==11&&timeinfo->tm_min==0)||(timeinfo->tm_hour==14&&timeinfo->tm_min==0)||(timeinfo->tm_hour==17&&timeinfo->tm_min==0)||(timeinfo->tm_hour==20&&timeinfo->tm_min==0)||(timeinfo->tm_hour==23&&timeinfo->tm_min==0))&&wloop==0){
         getwheatherinfo(timeinfo->tm_year+1900,timeinfo->tm_mon+1,timeinfo->tm_mday,(timeinfo->tm_hour-3+24)%24);  //한번 갱신하고 다시 실행 안되도록...
         wloop=1; //if안에 들어왔는지 체크 하고 위의 사용자 함수 실행후 나왔을때를 위해 체크
   }
   for(int i=0;i<5;i++){
   drawgettogetherday();
   drawtime();
   display.clearDisplay();
   }
   drawnowweather();
  display.clearDisplay();
  draw5weather();

                   //내부 타이머
      if(wloop!=0)
       wloopi++;
      if(wloopi==20){
       wloop=0;
       wloopi=0;
      }
       Serial.printf("%d %d\n",wloop,wloopi);
     if(timeinfo->tm_hour%3==0)
       Serial.printf("%d %d %d %d %d\n",timeinfo->tm_hour,(timeinfo->tm_hour+3)%24,(timeinfo->tm_hour+6)%24,(timeinfo->tm_hour+9)%24,(timeinfo->tm_hour+12)%24);
     if(timeinfo->tm_hour%3==1)
       Serial.printf("%d %d %d %d %d\n",(timeinfo->tm_hour-1)%24,(timeinfo->tm_hour+2)%24,(timeinfo->tm_hour+5)%24,(timeinfo->tm_hour+8)%24,(timeinfo->tm_hour+11)%24);
     if(timeinfo->tm_hour%3==2)
       Serial.printf("%d %d %d %d %d\n",(timeinfo->tm_hour-2)%24,(timeinfo->tm_hour+1)%24,(timeinfo->tm_hour+4)%24,(timeinfo->tm_hour+7)%24,(timeinfo->tm_hour+10)%24);
  
   }

void smartconfig(){ //기존 공유기 연결 못할시..
   WiFi.beginSmartConfig();
   Serial.println("Waiting for SmartConfig.");

  while (!WiFi.smartConfigDone()) {

  delay(500);
  Serial.print(".");
  Serial.println("");
  Serial.println("SmartConfig received.");

  //Wait for WiFi to connect to AP
  Serial.println("Waiting for WiFi");
  while (WiFi.status() != WL_CONNECTED) {
    delay(500);
    Serial.print(".");
  }

  Serial.println("WiFi Connected.");

  Serial.print("IP Address: ");
  Serial.println(WiFi.localIP());
  
  }
  }

void getwheatherinfo(int year,int mon,int day,int hour){//날씨 정보를 획득합니다.
    WiFiClient client;

    HTTPClient http;

     char s_year[500];
     char s_mon[10];
     char s_day[10];
     char s_hour[10];
     int cnt=0;
     
   if(mon<10){
    sprintf(s_mon,"0%d",mon);
    }
   else{
    sprintf(s_mon,"%d",mon);
    }
    if(day<10){
      sprintf(s_day,"0%d",day);
    }
   else{
    sprintf(s_day,"%d",day);
    }
    if(hour<10){
      sprintf(s_hour,"0%d",hour);
    }
   else{
    sprintf(s_hour,"%d",hour);
    }
    Serial.print("[HTTP] begin...\n");
   
    sprintf(s_year,"http://apis.data.go.kr/1360000/VilageFcstInfoService/getVilageFcst?serviceKey=MYkMEd1Kx5PWDad4K0CUzdminh1l8NocDD0sSSijoqivkQ%%2BdiwlZsSTq2pWRqO5KlmCFOlI5tA%%2B90TZhGDTaeA%%3D%%3D&numOfRows=60&base_date=%d%s%s&base_time=%s00&nx=57&ny=121&dataType=JSON",year,s_mon,s_day,s_hour);
    Serial.println(s_year);
    if (http.begin(client,s_year)) {  // HTTP


      Serial.print("[HTTP] GET...\n");
      // start connection and send HTTP header
      int httpCode = http.GET();

      // httpCode will be negative on error
      if (httpCode > 0) {
        // HTTP header has been send and Server response header has been handled
        Serial.printf("[HTTP] GET... code: %d\n", httpCode);

        // file found at server
        if (httpCode == HTTP_CODE_OK || httpCode == HTTP_CODE_MOVED_PERMANENTLY) {
          String payload = http.getString();
          Serial.println(payload);
         const size_t capacity=payload.length()*2;
          DynamicJsonDocument doc(capacity);

  // Parse JSON object
  DeserializationError error = deserializeJson(doc, payload);
  if (error) {
    Serial.print(F("deserializeJson() failed: "));
    Serial.println(error.c_str());
    return;
  }

  // Extract values
  Serial.println(F("Response:"));
  Serial.println(doc["response"]["body"]["numOfRows"].as<long>());
  
for(int i=0;i<doc["response"]["body"]["numOfRows"].as<long>();i++){

     if(strcmp("T3H",doc["response"]["body"]["items"]["item"][i]["category"].as<char *>())==0){
     nt[cnt++]=doc["response"]["body"]["items"]["item"][i]["fcstValue"].as<int>();
     if(cnt==sizeof(nt)/sizeof(int))
     break;
  }
    }
   cnt=0;
   for(int i=0;i<doc["response"]["body"]["numOfRows"].as<long>();i++){
     if(strcmp("PTY",doc["response"]["body"]["items"]["item"][i]["category"].as<char *>())==0){
      if(doc["response"]["body"]["items"]["item"][i]["fcstValue"].as<int>()==0){
           for(int i=0;i<doc["response"]["body"]["numOfRows"].as<long>();i++){
     if(strcmp("SKY",doc["response"]["body"]["items"]["item"][i]["category"].as<char *>())==0){
     sky[cnt++]=doc["response"]["body"]["items"]["item"][i]["fcstValue"].as<int>();
     break;
         }
      } 
      }else{
     sky[cnt++]=doc["response"]["body"]["items"]["item"][i]["fcstValue"].as<int>()+4; //sky와 중복을 피하기 위해
      }
  }
  if(cnt==sizeof(sky)/sizeof(int))
  break;
    } 

  if(hour==2){//최저기온+최고기온 갱신
    for(int i=0;i<doc["response"]["body"]["numOfRows"].as<long>();i++){
     if(strcmp("TMN",doc["response"]["body"]["items"]["item"][i]["category"].as<char *>())==0){
     tmn=doc["response"]["body"]["items"]["item"][i]["fcstValue"].as<double>()*10/10;
  }
   if(strcmp("TMX",doc["response"]["body"]["items"]["item"][i]["category"].as<char *>())==0){
     tmx=doc["response"]["body"]["items"]["item"][i]["fcstValue"].as<double>()*10/10;
     break;
  }
    } 
    }
  if(hour==5||hour==8||hour==11){//최고기온 갱신
    for(int i=0;i<doc["response"]["body"]["numOfRows"].as<long>();i++){
    if(strcmp("TMX",doc["response"]["body"]["items"]["item"][i]["category"].as<char *>())==0){
     tmx=doc["response"]["body"]["items"]["item"][i]["fcstValue"].as<double>()*10/10;
     break;
  }
    } 
  }
        }
      } else {
        Serial.printf("[HTTP] GET... failed, error: %s\n", http.errorToString(httpCode).c_str());
      }

      http.end();
    } else {
      Serial.printf("[HTTP} Unable to connect\n");
    }

for(int i=0;i<sizeof(skyimgary)/sizeof(char *);i++){
  if(i==0){
  if(sky[0]==1)
   *skyimgary[0]=sunny64;
  if(sky[0]==3)
  *skyimgary[0]=cloudy64;
  if(sky[0]==4)
  *skyimgary[0]=overcast64;
   if(sky[0]==5)
  *skyimgary[0]=rainy64;
   if(sky[0]==6)
  *skyimgary[0]=sleet64;
   if(sky[0]==7)
  *skyimgary[0]=snow64;
  if(sky[0]==8)
  *skyimgary[0]=rcd64;
  }
  else{
    if(sky[i]==1)
   *skyimgary[i]=sunny32;
  if(sky[i]==3)
  *skyimgary[i]=cloudy32;
  if(sky[i]==4)
  *skyimgary[i]=overcast32;
   if(sky[i]==5)
  *skyimgary[i]=rainy32;
   if(sky[i]==6)
  *skyimgary[i]=sleet32;
   if(sky[i]==7)
  *skyimgary[i]=snow32;
  if(sky[i]==8)
  *skyimgary[i]=rcd32;
    }
  }
 
  }
void drawnowweather(){
  display.drawBitmap(0,0,*skyimgary[0],64,64, WHITE);
 // display.drawBitmap(100,10,c,32,32, WHITE);
  display.setCursor(70,10);
   display.setTextSize(3);
  display.print(nt[0]);
  display.write(9);
  display.setCursor(70,40);
  display.setTextSize(1);
  display.print(tmn);
  display.print("/");
  display.print(tmx);
  display.display();
  Serial.printf("날씨 %d,%d,%d,%d,%d,%d\n",sky[0],sky[1],sky[2],sky[3],sky[4],sky[5]);
  Serial.printf("기온 %d,%d,%d,%d,%d,%d\n",nt[0],nt[1],nt[2],nt[3],nt[4],nt[5]);
  delay(5000);
  }  
void draw5weather(){

  display.setTextSize(1);
   time_t now = time(NULL);
  struct tm* timeinfo;
  timeinfo=localtime(&now);
  display.drawBitmap(0,20,*skyimgary[1],32,32, WHITE);
  display.drawBitmap(32,20,*skyimgary[2],32,32, WHITE);
  display.drawBitmap(64,20,*skyimgary[3],32,32, WHITE);
  display.drawBitmap(96,20,*skyimgary[4],32,32, WHITE);
  display.drawBitmap(128,20,*skyimgary[5],32,32, WHITE);
    display.setCursor(10,0);
    display.print(nt[1]);
    display.write(9);
    display.setCursor(42,0);
    display.print(nt[2]);
    display.write(9);
    display.setCursor(75,0);
    display.print(nt[3]);
    display.write(9);
    display.setCursor(107,0);
    display.print(nt[4]);
    display.write(9);
 
   if(timeinfo->tm_hour%3==0){
    display.setCursor(10,56);
    display.print((timeinfo->tm_hour+3)%24);
    display.setCursor(42,56);
    display.print((timeinfo->tm_hour+6)%24);
    display.setCursor(74,56);
    display.print((timeinfo->tm_hour+9)%24);
    display.setCursor(106,56);
    display.print((timeinfo->tm_hour+12)%24);
 
      }
     if(timeinfo->tm_hour%3==1){
    
    display.setCursor(10,56);
    display.print((timeinfo->tm_hour+2)%24);
    display.setCursor(42,56);
    display.print((timeinfo->tm_hour+5)%24);
    display.setCursor(74,56);
    display.print((timeinfo->tm_hour+8)%24);
    display.setCursor(106,56);
    display.print((timeinfo->tm_hour+11)%24);

      }
     if(timeinfo->tm_hour%3==2){
    
     display.setCursor(10,56);
    display.print((timeinfo->tm_hour+1)%24);
     display.setCursor(42,56);
    display.print((timeinfo->tm_hour+4)%24);
    display.setCursor(74,56);
    display.print((timeinfo->tm_hour+7)%24);
     display.setCursor(106,56);
    display.print((timeinfo->tm_hour+10)%24);
  
     }
    display.drawBitmap(22,50,hourfont,14,15, WHITE);
    display.drawBitmap(54,50,hourfont,14,15, WHITE);
    display.drawBitmap(87,50,hourfont,14,15, WHITE);
    display.drawBitmap(119,50,hourfont,14,15, WHITE);
      display.display();
      delay(10000);
      
  }
  
void drawgettogetherday(){
   display.setCursor(40,25);
   display.setTextSize(2);
   time_t now = time(NULL);
  struct tm* timeinfo;
  timeinfo=localtime(&now);
  display.print(c_result);
 Serial.printf("%d일 사겼습니다.2\n", c_result);
  display.drawBitmap(0,16, heart, 32, 32, WHITE);
 display.drawBitmap(96,16, heart, 32, 32, WHITE);
 
  }
  
void drawtime(){
   display.setCursor(50,50);
    display.setTextSize(1);
   time_t now = time(NULL);
  struct tm* timeinfo;
  timeinfo=localtime(&now);
   if(timeinfo->tm_hour<13){
    if(timeinfo->tm_hour<10)
    display.print('0');
    display.drawBitmap(26,45,morningfont,32,15, WHITE);
     display.print(timeinfo->tm_hour);
    }else{
        if(timeinfo->tm_hour<22)
        display.print('0');
       display.drawBitmap(26,45,afternoonfont,32,15, WHITE);
       display.print(timeinfo->tm_hour-12);
      }
  display.print(":");
  if(timeinfo->tm_min<10)
    display.print(0);
  display.print(timeinfo->tm_min);
  display.print(":");
  if(timeinfo->tm_sec<10)
  display.print(0);
  display.print(timeinfo->tm_sec);
  Serial.printf("현재시간:%d시%d%분%d초\n",timeinfo->tm_hour,timeinfo->tm_min,timeinfo->tm_sec);
  display.display();
  delay(1000);
  }

  
void countgettogether(int year,int mon,int day){
  
  int y=year;
  int m=mon+1;
  int d=day;                                                //현재 년월일
  int t_sum = 0;                                        //살아온날의 합
  int i;

 

  //살아온 날의 합 계산
  for (i = 115; i < y; i++)
  {
    t_sum += date_sum(i, 12, 31);
  }
  t_sum += date_sum(y, m, d);                        //현재까지 날짜 더함
  t_sum -= date_sum(115,11,6);        //생년1월1일부터 태어난 날까지 합을 빼줌

  

   c_result=t_sum;
  }
  int test_leap_year(int year)
{
  if (year % 4 == 0) {
    if (year % 100 == 0) {
      if (year % 400 == 0)
        return 0;                        //윤년
      else
        return 1;
    }
    else
      return 0;                                //윤년
  }
  else
    return 1;                                        //평년        
}

int date_sum(int y, int m, int d)
{
  int sum = 0;
  int i;
  int test = test_leap_year(y);

  for (i = 1; i < m; i++)
  {
    if (i == 1 || i == 3 || i == 5 || i == 7 || i == 8 || i == 10 || i == 12)
      sum += 31;
    else if (i == 2)
    {
      if (test == 1)                        //해당 연도가 평년일 경우
        sum += 28;
      else
        sum += 29;                //해당 연도가 윤년일 경우
    }
    else
      sum += 30;
  }
  sum += d;                                                //오늘 날짜 더함
  return sum;
}
